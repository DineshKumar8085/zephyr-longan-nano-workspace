## hello_world/build/Kconfig/arch/Kconfig
```kconfig
# Load Zephyr Arch Kconfig descriptions.
osource "/home/dinesh/Documents/zephyrproject/zephyr/arch/rx/Kconfig"
osource "/home/dinesh/Documents/zephyrproject/zephyr/arch/x86/Kconfig"
osource "/home/dinesh/Documents/zephyrproject/zephyr/arch/xtensa/Kconfig"
osource "/home/dinesh/Documents/zephyrproject/zephyr/arch/sparc/Kconfig"
osource "/home/dinesh/Documents/zephyrproject/zephyr/arch/riscv/Kconfig"
osource "/home/dinesh/Documents/zephyrproject/zephyr/arch/posix/Kconfig"
osource "/home/dinesh/Documents/zephyrproject/zephyr/arch/mips/Kconfig"
osource "/home/dinesh/Documents/zephyrproject/zephyr/arch/arm64/Kconfig"
osource "/home/dinesh/Documents/zephyrproject/zephyr/arch/arm/Kconfig"
osource "/home/dinesh/Documents/zephyrproject/zephyr/arch/arc/Kconfig"
```

## hello_world/build/Kconfig/boards/Kconfig.defconfig
```kconfig
# Load Zephyr board defconfig descriptions.
osource "/home/dinesh/Documents/zephyrproject/zephyr/boards/qemu/x86/Kconfig.defconfig"
```

## hello_world/build/Kconfig/boards/Kconfig.sysbuild
```kconfig
# Load Sysbuild board Kconfig descriptions.
osource "/home/dinesh/Documents/zephyrproject/zephyr/boards/qemu/x86/Kconfig.sysbuild"
```

## i2c_test/build/Kconfig/boards/Kconfig
```kconfig
# Load Zephyr board Kconfig descriptions.
osource "/home/dinesh/Documents/zephyrproject/zephyr/boards/sipeed/longan_nano/Kconfig"
```

## i2c_test/build/Kconfig/boards/Kconfig.defconfig
```kconfig
# Load Zephyr board defconfig descriptions.
osource "/home/dinesh/Documents/zephyrproject/zephyr/boards/sipeed/longan_nano/Kconfig.defconfig"
```

## i2c_test/build/Kconfig/boards/Kconfig.longan_nano
```kconfig
# Load board Kconfig descriptions.
osource "/home/dinesh/Documents/zephyrproject/zephyr/boards/sipeed/longan_nano/Kconfig.longan_nano"
```

## spi_display/build/Kconfig/boards/Kconfig.sysbuild
```kconfig
# Load Sysbuild board Kconfig descriptions.
osource "/home/dinesh/Documents/zephyrproject/zephyr/boards/sipeed/longan_nano/Kconfig.sysbuild"
```
