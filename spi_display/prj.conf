## CMakeLists.txt
```
cmake_minimum_required(VERSION 3.20.0)

find_package(Zephyr REQUIRED HINTS $ENV{ZEPHYR_BASE})

project(spi_display)

target_sources(app PRIVATE
    src/main.c
    src/lcd_text.c
    src/font5x7.c
)
```

## prj.conf
```kconfig
CONFIG_I2C=y
CONFIG_SPI=y
CONFIG_GPIO=y

CONFIG_DISPLAY=y
CONFIG_ST7735R=y
CONFIG_MIPI_DBI=y

CONFIG_PRINTK=y
CONFIG_LOG=y

CONFIG_MAIN_STACK_SIZE=1024
```

## src/main.c
```c
#include <zephyr/kernel.h>
#include <zephyr/device.h>
#include <zephyr/drivers/i2c.h>
#include <zephyr/drivers/display.h>
#include <zephyr/sys/printk.h>

#include "lcd_text.h"

#define I2C_NODE DT_NODELABEL(i2c0)
#define DISPLAY_NODE DT_CHOSEN(zephyr_display)

#define MPU_ADDR 0x68
#define PWR_MGMT_1 0x6B
#define DATA_START 0x3B

int main(void)
{

    const struct device *i2c = DEVICE_DT_GET(I2C_NODE);
    const struct device *lcd = DEVICE_DT_GET(DISPLAY_NODE);

    if(!device_is_ready(i2c) || !device_is_ready(lcd))
        return 0;

    lcd_clear(lcd);

    lcd_draw_string(lcd,20,0,"MPU6050 DASH");

    uint8_t wake[2] = {PWR_MGMT_1,0x01};
    i2c_write(i2c,wake,2,MPU_ADDR);

    while(1)
{
    lcd_clear(lcd);

    uint8_t reg = DATA_START;
    uint8_t data[14];

    i2c_write_read(i2c, MPU_ADDR, &reg, 1, data, 14);

    int16_t ax_raw = (data[0]<<8)|data[1];
    int16_t ay_raw = (data[2]<<8)|data[3];
    int16_t az_raw = (data[4]<<8)|data[5];

    int16_t gx_raw = (data[8]<<8)|data[9];
    int16_t gy_raw = (data[10]<<8)|data[11];
    int16_t gz_raw = (data[12]<<8)|data[13];

    int16_t temp_raw = (data[6]<<8)|data[7];

    /* Convert to physical units */

    int ax = (ax_raw * 1000) / 16384;
    int ay = (ay_raw * 1000) / 16384;
    int az = (az_raw * 1000) / 16384;

    int gx = (gx_raw * 100) / 131;
    int gy = (gy_raw * 100) / 131;
    int gz = (gz_raw * 100) / 131;

    int temp = (temp_raw * 100) / 340 + 3653;

    /* UART Output */

    printk("\n");
    printk("ACCEL [mg]  X:%d  Y:%d  Z:%d\n", ax, ay, az);
    printk("GYRO  [dps] X:%d  Y:%d  Z:%d\n", gx, gy, gz);
    printk("TEMP  [C*100]: %d\n", temp);

    /* LCD Output */

    lcd_clear(lcd);

    lcd_draw_string(lcd,20,0,"MPU6050 DASH");

    lcd_draw_string(lcd,0,15,"AX:");
    lcd_draw_int(lcd,30,15,ax);

    lcd_draw_string(lcd,0,25,"AY:");
    lcd_draw_int(lcd,30,25,ay);

    lcd_draw_string(lcd,0,35,"AZ:");
    lcd_draw_int(lcd,30,35,az);

    lcd_draw_string(lcd,80,15,"GX:");
    lcd_draw_int(lcd,110,15,gx);

    lcd_draw_string(lcd,80,25,"GY:");
    lcd_draw_int(lcd,110,25,gy);

    lcd_draw_string(lcd,80,35,"GZ:");
    lcd_draw_int(lcd,110,35,gz);

    lcd_draw_string(lcd,0,60,"TEMP:");
    lcd_draw_int(lcd,50,60,temp);

    k_sleep(K_MSEC(800));
}
}
```

## src/font5x7.c
```c
#include "font5x7.h"

const uint8_t font5x7[][5] = {

/* space */
{0x00,0x00,0x00,0x00,0x00},

/* digits */
{0x3E,0x51,0x49,0x45,0x3E}, //0
{0x00,0x42,0x7F,0x40,0x00}, //1
{0x62,0x51,0x49,0x49,0x46}, //2
{0x22,0x49,0x49,0x49,0x36}, //3
{0x18,0x14,0x12,0x7F,0x10}, //4
{0x2F,0x49,0x49,0x49,0x31}, //5
{0x3E,0x49,0x49,0x49,0x32}, //6
{0x01,0x71,0x09,0x05,0x03}, //7
{0x36,0x49,0x49,0x49,0x36}, //8
{0x26,0x49,0x49,0x49,0x3E}, //9

/* letters needed for display */

{0x7E,0x11,0x11,0x11,0x7E}, // A
{0x7F,0x49,0x49,0x49,0x36}, // B
{0x3E,0x41,0x41,0x41,0x22}, // C
{0x7F,0x41,0x41,0x22,0x1C}, // D
{0x7F,0x49,0x49,0x49,0x41}, // E
{0x7F,0x09,0x09,0x09,0x01}, // F
{0x3E,0x41,0x49,0x49,0x7A}, // G
{0x7F,0x08,0x08,0x08,0x7F}, // H
{0x00,0x41,0x7F,0x41,0x00}, // I
{0x20,0x40,0x41,0x3F,0x01}, // J
{0x7F,0x08,0x14,0x22,0x41}, // K
{0x7F,0x40,0x40,0x40,0x40}, // L
{0x7F,0x02,0x04,0x02,0x7F}, // M
{0x7F,0x04,0x08,0x10,0x7F}, // N
{0x3E,0x41,0x41,0x41,0x3E}, // O
{0x7F,0x09,0x09,0x09,0x06}, // P
{0x3E,0x41,0x51,0x21,0x5E}, // Q
{0x7F,0x09,0x19,0x29,0x46}, // R
{0x46,0x49,0x49,0x49,0x31}, // S
{0x01,0x01,0x7F,0x01,0x01}, // T
{0x3F,0x40,0x40,0x40,0x3F}, // U
{0x1F,0x20,0x40,0x20,0x1F}, // V
{0x7F,0x20,0x18,0x20,0x7F}, // W
{0x63,0x14,0x08,0x14,0x63}, // X
{0x07,0x08,0x70,0x08,0x07}, // Y
{0x61,0x51,0x49,0x45,0x43}, // Z

/* colon */
{0x00,0x36,0x36,0x00,0x00}  // :
};
```

## src/font5x7.h
```c
#pragma once

#include <stdint.h>

extern const uint8_t font5x7[][5];
```

## src/lcd_text.h
```c
#pragma once

#include <zephyr/device.h>

void lcd_clear(const struct device *dev);

void lcd_draw_char(const struct device *dev,int x,int y,char c);

void lcd_draw_string(const struct device *dev,int x,int y,const char *str);

void lcd_draw_int(const struct device *dev,int x,int y,int value);
```
