## CMakeLists.txt
```
cmake_minimum_required(VERSION 3.20.0)
find_package(Zephyr REQUIRED HINTS $ENV{ZEPHYR_BASE})
project(mpu_uart_cmd)

target_sources(app PRIVATE src/main.c 
				src/lcd_text.c 
				src/font5x7.c
				src/drivers/mpu6050.c
				src/sensor.c
				src/cli.c
				src/main.c
				)
```

## prj.conf
```kconfig
CONFIG_I2C=y
CONFIG_SPI=y
CONFIG_GPIO=y

CONFIG_DISPLAY=y
CONFIG_ST7735R=y
CONFIG_MIPI_DBI=y

CONFIG_PRINTK=y
CONFIG_LOG=y

CONFIG_MAIN_STACK_SIZE=4096

CONFIG_SERIAL=y
CONFIG_UART_INTERRUPT_DRIVEN=y
CONFIG_CONSOLE=y
```

## src/main.c
```c
#include <zephyr/kernel.h>
#include "cli.h"
#include "sensor.h"

int main(void)
{
    sensor_init();
    cli_init();

    return 0;
}
```

## src/cli.c
```c
#include <zephyr/kernel.h>
#include <zephyr/device.h>
#include <zephyr/drivers/uart.h>
#include <zephyr/sys/printk.h>
#include <string.h>
#include <stdlib.h>

#include "cli.h"
#include "sensor.h"

#define UART_NODE DT_CHOSEN(zephyr_console)
#define CMD_BUF_SIZE 64
#define PROMPT "longan@board:~$ "

static const struct device *uart_dev;
static char rx_buf[CMD_BUF_SIZE];
static int rx_pos = 0;

K_MSGQ_DEFINE(cmd_queue, CMD_BUF_SIZE, 5, 4);

/* ================= UART ISR ================= */

void uart_cb(const struct device *dev, void *user_data)
{
    uint8_t c;

    while (uart_irq_update(dev) && uart_irq_rx_ready(dev)) {
        uart_fifo_read(dev, &c, 1);

        /* Backspace */
        if (c == 0x08 || c == 0x7F) {
            if (rx_pos > 0) {
                rx_pos--;
                uart_poll_out(dev, '\b');
                uart_poll_out(dev, ' ');
                uart_poll_out(dev, '\b');
            }
            continue;
        }

        uart_poll_out(dev, c);

        if (c == '\r' || c == '\n') {
            uart_poll_out(dev, '\r');
            uart_poll_out(dev, '\n');

            rx_buf[rx_pos] = '\0';
            k_msgq_put(&cmd_queue, rx_buf, K_NO_WAIT);

            rx_pos = 0;
        } else {
            if (rx_pos < CMD_BUF_SIZE - 1)
                rx_buf[rx_pos++] = c;
        }
    }
}

/* ================= CLI THREAD ================= */

void cli_thread(void *a, void *b, void *c)
{
    char cmd[CMD_BUF_SIZE];

    printk("CLI READY\n");
    printk(PROMPT);

    while (1)
    {
        k_msgq_get(&cmd_queue, cmd, K_FOREVER);

        /* ===== TRIM ===== */
        for (int i = strlen(cmd)-1; i >= 0; i--) {
            if (cmd[i]=='\r'||cmd[i]=='\n'||cmd[i]==' ')
                cmd[i]='\0';
            else break;
        }

        struct mpu_data d = sensor_get_data();

        /* ===== COMMANDS ===== */

        if (strcmp(cmd, "GET ACCEL") == 0) {
            printk("ACCEL %d %d %d\n", d.ax, d.ay, d.az);
        }
        else if (strcmp(cmd, "GET GYRO") == 0) {
            printk("GYRO %d %d %d\n", d.gx, d.gy, d.gz);
        }
        else if (strcmp(cmd, "GET TEMP") == 0) {
            printk("TEMP %d\n", d.temp);
        }
        else if (strcmp(cmd, "GET ALL") == 0) {
            printk("ACC %d %d %d | GY %d %d %d | T %d\n",
                   d.ax, d.ay, d.az,
                   d.gx, d.gy, d.gz,
                   d.temp);
        }
        else if (strcmp(cmd, "LCD OFF") == 0) {
            sensor_lcd_enable(0);
            printk("LCD OFF\n");
        }
        else if (strcmp(cmd, "LCD ON") == 0) {
            sensor_lcd_enable(1);
            printk("LCD ON\n");
        }
        else if (strncmp(cmd, "SET RATE", 8) == 0) {
            int rate = atoi(cmd + 9);
            sensor_set_rate(rate);
            printk("RATE SET TO %d ms\n", rate);
        }
        else if (strcmp(cmd, "HELP") == 0) {
            printk("Commands:\n");
            printk("GET ACCEL\nGET GYRO\nGET TEMP\nGET ALL\n");
            printk("LCD ON\nLCD OFF\n");
            printk("SET RATE <ms>\n");
        }
        else {
            printk("ERR:UNKNOWN_CMD\n");
        }

        printk(PROMPT);
    }
}

/* ================= INIT ================= */

void cli_init(void)
{
    uart_dev = DEVICE_DT_GET(UART_NODE);

    uart_irq_callback_user_data_set(uart_dev, uart_cb, NULL);
    uart_irq_rx_enable(uart_dev);
}

K_THREAD_DEFINE(cli_tid, 4096, cli_thread, NULL, NULL, NULL, 7, 0, 0);
```

## src/cli.h
```c
#pragma once
void cli_init(void);
```

## src/font5x7.h
```c
#pragma once

#include <stdint.h>

extern const uint8_t font5x7[][5];
```

## src/lcd_text.c
```c
#include <zephyr/drivers/display.h>
#include <zephyr/sys/printk.h>
#include <string.h>

#include "lcd_text.h"
#include "font5x7.h"

#define LCD_W 160
#define CHAR_W 6
#define CHAR_H 8

static uint16_t pixel_buf[CHAR_W * CHAR_H];

void lcd_draw_char(const struct device *dev, int x, int y, char c)
{

    int idx = -1;

    /* numbers */
    if (c >= '0' && c <= '9')
        idx = c - '0' + 1;

    /* letters */
    else if (c >= 'A' && c <= 'Z')
        idx = c - 'A' + 11;

    /* colon */
    else if (c == ':')
        idx = 37;

    /* space */
    else if (c == ' ')
        idx = 0;

    if (idx < 0)
        return;

    memset(pixel_buf, 0, sizeof(pixel_buf));

    for (int col = 0; col < 5; col++)
    {

        uint8_t bits = font5x7[idx][col];

        for (int row = 0; row < 7; row++)
        {

            if (bits & (1 << row))
                pixel_buf[row * CHAR_W + col] = 0xFFFF;

        }
    }

    struct display_buffer_descriptor desc =
    {
        .width = CHAR_W,
        .height = CHAR_H,
        .pitch = CHAR_W,
        .buf_size = sizeof(pixel_buf)
    };

    display_write(dev, x, y, &desc, pixel_buf);
}


void lcd_draw_string(const struct device *dev, int x, int y, const char *str)
{

    int cursor = x;

    while (*str)
    {
        lcd_draw_char(dev, cursor, y, *str);
        cursor += CHAR_W;
        str++;
    }

}


void lcd_draw_int(const struct device *dev, int x, int y, int value)
{

    char buf[16];

    snprintk(buf, sizeof(buf), "%d", value);

    lcd_draw_string(dev, x, y, buf);
}


void lcd_clear(const struct device *dev)
{

    static uint16_t line[LCD_W];

    memset(line, 0, sizeof(line));

    struct display_buffer_descriptor desc =
    {
        .width = LCD_W,
        .height = 1,
        .pitch = LCD_W,
        .buf_size = sizeof(line)
    };

    for (int y = 0; y < 80; y++)
    {
        display_write(dev, 0, y, &desc, line);
    }
}
```

## src/sensor.c
```c
#include <zephyr/kernel.h>
#include <zephyr/device.h>
#include <zephyr/drivers/i2c.h>
#include <zephyr/sys/printk.h>

#include "sensor.h"
#include "drivers/mpu6050.h"
#include "lcd_text.h"

#define I2C_NODE DT_NODELABEL(i2c0)
#define DISPLAY_NODE DT_CHOSEN(zephyr_display)

static struct mpu_data mpu;
K_MUTEX_DEFINE(mpu_mutex);

static const struct device *i2c_dev;
static const struct device *lcd_dev;

static int lcd_enabled = 1;
static int sample_rate = 800;

void sensor_init(void)
{
    i2c_dev = DEVICE_DT_GET(I2C_NODE);
    lcd_dev = DEVICE_DT_GET(DISPLAY_NODE);

    if (!device_is_ready(i2c_dev)) {
        printk("I2C NOT READY\n");
        return;
    }

    mpu6050_init(i2c_dev);
}

void sensor_set_rate(int rate)
{
    sample_rate = rate;
}

void sensor_lcd_enable(int enable)
{
    lcd_enabled = enable;
    /* Immediately clear when turning OFF */
    if (!enable && lcd_dev && device_is_ready(lcd_dev)) {
        lcd_clear(lcd_dev);
    }
}

struct mpu_data sensor_get_data(void)
{
    struct mpu_data copy;

    k_mutex_lock(&mpu_mutex, K_FOREVER);
    copy = mpu;
    k_mutex_unlock(&mpu_mutex);

    return copy;
}

/* THREAD */
void sensor_thread(void *a, void *b, void *c)
{
    while (1)
    {
        struct mpu_data temp;

        if (mpu6050_read(i2c_dev, &temp) == 0) {

            k_mutex_lock(&mpu_mutex, K_FOREVER);
            mpu = temp;
            k_mutex_unlock(&mpu_mutex);

            if (lcd_enabled && device_is_ready(lcd_dev)) {

                lcd_clear(lcd_dev);

                lcd_draw_string(lcd_dev,20,0,"MPU6050 DASH");

                lcd_draw_string(lcd_dev,0,15,"AX:");
                lcd_draw_int(lcd_dev,30,15,temp.ax);

                lcd_draw_string(lcd_dev,0,25,"AY:");
                lcd_draw_int(lcd_dev,30,25,temp.ay);

                lcd_draw_string(lcd_dev,0,35,"AZ:");
                lcd_draw_int(lcd_dev,30,35,temp.az);

                lcd_draw_string(lcd_dev,80,15,"GX:");
                lcd_draw_int(lcd_dev,110,15,temp.gx);

                lcd_draw_string(lcd_dev,80,25,"GY:");
                lcd_draw_int(lcd_dev,110,25,temp.gy);

                lcd_draw_string(lcd_dev,80,35,"GZ:");
                lcd_draw_int(lcd_dev,110,35,temp.gz);

                lcd_draw_string(lcd_dev,0,60,"TEMP:");
                lcd_draw_int(lcd_dev,50,60,temp.temp);
            }
            else {
            if (lcd_dev && device_is_ready(lcd_dev)) {
            lcd_clear(lcd_dev);
            }
            }
        }

        k_sleep(K_MSEC(sample_rate));
    }
}

K_THREAD_DEFINE(sensor_tid, 4096, sensor_thread, NULL, NULL, NULL, 5, 0, 0);
```

## src/sensor.h
```c
#pragma once

struct mpu_data {
    int ax, ay, az;
    int gx, gy, gz;
    int temp;
};

void sensor_init(void);
struct mpu_data sensor_get_data(void);

/* NEW CONTROL FUNCTIONS */
void sensor_set_rate(int rate);
void sensor_lcd_enable(int enable);
```
